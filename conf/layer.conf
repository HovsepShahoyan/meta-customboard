## conf/layer.conf
```bitbake
# We have a conf and classes directory, add to BBPATH
BBPATH .= ":${LAYERDIR}"

# We have a pacikages drectory, add to BBFILES
BBFILES += "${LAYERDIR}/recipes-*/*/*.bb \
            ${LAYERDIR}/recipes-*/*/*.bbappend"

BBFILE_COLLECTIONS += "meta-customboard"
BBFILE_PATTERN_meta-taurotech-lx2 = "^${LAYERDIR}/"
BBFILE_PRIORITY_meta-taurotech-lx2 = "10"
LAYERSERIES_COMPAT_meta-taurotech-lx2= "kirkstone langdale mickledore nanbield scarthgap"
LAYERDEPENDS_meta-taurotech-lx2= "core"
```
